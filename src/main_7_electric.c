/**************************************************************************************
实验现象：下载程序后，直流电机旋转大约5S，然后停止
		  
接线说明： (具体接线图可见开发攻略对应实验的“实验现象”章节)
		   1，单片机-->五线四相步进电机模块
		   		P10-->IN1
		   2，五线四相步进电机模块输出-->直流电机
		   		5V-->直流电机两脚任意一个
				O1-->直流电机两脚任意一个	
	
注意事项：																				

  
***************************************************************************************/

#include "reg52.h"			 //此文件中定义了单片机的一些特殊功能寄存器
#include<intrins.h>		//因为要用到左右移函数，所以加入这个头文件

typedef unsigned int u16;	  //对数据类型进行声明定义
typedef unsigned char u8;

sbit moto=P1^0;	  	 


void delay7(u16 i)
{
	while(i--);	
}


void main7()
{	
	u8 i, j;
	
	moto=0;			//关闭电机
	for(j=0; j<10; j++)
	{
		for(i=0;i<10;i++)	  //循环100次，也就是大约5S
		{
			moto=1;			 //开启电机
			delay7(5000);	//大约延时50ms
		}
		moto=0;			//关闭电机
		delay7(50000);	//大约延时500ms
	}
	
	while(1)
	{	
						
	}
}
